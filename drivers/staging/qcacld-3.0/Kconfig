## drivers/staging/qcacld-3.0/Kconfig
```kconfig
comment "Qualcomm Atheros CLD WLAN module"

config QCA_CLD_WLAN
	tristate "Qualcomm Atheros CLD WLAN module"
	default n
	help
	  Add support for the Qualcomm Atheros CLD WLAN module

if QCA_CLD_WLAN != n

config QCA_CLD_WLAN_PROFILE
	string "Configuration profile for Qualcomm Atheros CLD WLAN module"
	default "default"
	help
	  Specify which configuration profile to be used for building
	  this module.

	  Profiles are located at drivers/staging/qcacld-3.0/configs.

config QCA_CLD_WLAN_DYNAMIC_SINGLE_CHIP_NAME
	string "Dynamic single chip name for the Qualcomm Atheros CLD WLAN module"
	default ""
	help
	  Specify the chip name to be used by the Qualcomm Atheros CLD WLAN
	  module.

	  This is used to load the userspace WCNSS_qcom_cfg.ini from a
	  certain subfolder.
	  It will load from
	  /vendor/firmware/wlan/qca_cld/<QCA_CLD_WLAN_DYNAMIC_SINGLE_CHIP_NAME>

config AGEIE_ON_SCAN_RESULTS
	bool "Enable AGEIE_ON_SCAN_RESULTS"
	default n

config INTERFACE_MGR
	bool "Enable INTERFACE_MGR"
	default n

config ENABLE_LOW_POWER_MODE
	bool "Enable ENABLE_LOW_POWER_MODE"
	default n

config CNSS_ADRASTEA
	bool "Enable CONFIG_CNSS_ADRASTEA"
	default n

menu "Optional Configs"

if CNSS_ADRASTEA

config MULTI_IF_NAME
	string "Enable CONFIG_MULTI_IF_NAME"
	default adrastea

endif
endmenu
endif # QCA_CLD_WLAN
```
